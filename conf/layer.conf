## conf/layer.conf
```bitbake
# We have a conf directory, add to BBPATH
BBPATH := "${BBPATH}:${LAYERDIR}"

# We have a recipes directory containing .bb and .bbappend files, add to BBFILES
BBFILES := "${BBFILES} ${LAYERDIR}/recipes*/*/*.bb \
            ${LAYERDIR}/recipes*/*/*.bbappend"

BBFILE_COLLECTIONS += "youconnect-apps"
BBFILE_PATTERN_youconnect-apps := "^${LAYERDIR}/"
BBFILE_PRIORITY_youconnect-apps = "5"
```
